/*
 * Top level DTS file for CVM:P3668-0001 and CVB:P3509-0000.
 *
 * Copyright (c) 2019-2020, NVIDIA CORPORATION.  All rights reserved.
 *
 * This program is free software; you can redistribute it and/or modify
 * it under the terms of the GNU General Public License as published by
 * the Free Software Foundation; version 2 of the License.
 *
 * This program is distributed in the hope that it will be useful, but WITHOUT
 * ANY WARRANTY; without even the implied warranty of MERCHANTABILITY or
 * FITNESS FOR A PARTICULAR PURPOSE.  See the GNU General Public License for
 * more details.
 */

/dts-v1/;
#include "common/tegra194-p3668-common.dtsi"
#include "common/tegra194-p3509-0000-a00.dtsi"
#include "common/mirp-common.dtsi"

/ {
	nvidia,dtsfilename = __FILE__;
	nvidia,dtbbuildtime = __DATE__, __TIME__;

	compatible = "nvidia,p3449-0000+p3668-0000", "nvidia,p3449-0000+p3668-0001", "nvidia,p3509-0000+p3668-0000", "nvidia,p3509-0000+p3668-0001", "nvidia,tegra194";

	pcie@141a0000 {
	nvidia,disable-aspm-states = <0x0>;
	/delete-property/ nvidia,disable-clock-request;
	nvidia,dvfs-tbl = < 204000000 204000000 204000000 204000000
	 204000000 204000000 204000000 204000000
	 204000000 204000000 204000000 204000000
	 204000000 204000000 204000000 204000000 >;
 };
	//add by jia to add dai-link for audio PA tas5805
	sound {
		nvidia,dai-link-5 {
			link-name = "tas5805-codec";
			cpu-dai = <&tegra_i2s5>;
			codec-dai = <&tas5805m>;
			cpu-dai-name = "I2S5";
			codec-dai-name = "tas5805m-amplifier";
			format = "i2s";
			bit-format = "s16_le";
			srate = <48000>;
			num-channel = <1>;
			ignore_suspend;
			status = "okay";
		};
	};
};
